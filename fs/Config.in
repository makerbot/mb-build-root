## fs/Config.in
```kconfig
menu "Filesystem images"

config BR2_TARGET_ROOTFS_DEPS
	bool "build filesystem creation dependencies"
	help
	  This does not actually build a filesytem image, but creates
	  several dependencies to make it easier for other scripts to
	  create a filesystem image.

source "fs/cloop/Config.in"
source "fs/cpio/Config.in"
source "fs/cramfs/Config.in"
source "fs/ext2/Config.in"
source "fs/initramfs/Config.in"
source "fs/iso9660/Config.in"
source "fs/jffs2/Config.in"
source "fs/romfs/Config.in"
source "fs/squashfs/Config.in"
source "fs/tar/Config.in"
source "fs/ubifs/Config.in"

endmenu
```

## mbdefconfig
```kconfig
BR2_arm=y
BR2_cortex_a9=y
BR2_ARM_EABIHF=y
BR2_ARM_ENABLE_NEON=y
BR2_JLEVEL=4
BR2_TOOLCHAIN_EXTERNAL=y
BR2_TOOLCHAIN_EXTERNAL_CUSTOM=y
BR2_TOOLCHAIN_EXTERNAL_PATH=""
BR2_TOOLCHAIN_EXTERNAL_CUSTOM_PREFIX="arm-linux-gnueabihf"
BR2_TOOLCHAIN_EXTERNAL_GCC_5=y
BR2_TOOLCHAIN_EXTERNAL_HEADERS_4_0=y
BR2_TOOLCHAIN_EXTERNAL_CUSTOM_GLIBC=y
BR2_TOOLCHAIN_EXTERNAL_CXX=y
BR2_TARGET_GENERIC_HOSTNAME="morepork"
BR2_TARGET_GENERIC_ISSUE="You can make things with a MakerBot, oh yes, oh yes you can!!!"
BR2_INIT_SYSTEMD=y
# BR2_TARGET_GENERIC_REMOUNT_ROOTFS_RW is not set
BR2_PACKAGE_BUSYBOX_CONFIG=""
BR2_PACKAGE_BZIP2=y
BR2_PACKAGE_GDB=y
BR2_PACKAGE_GDB_DEBUGGER=y
BR2_PACKAGE_STRACE=y
BR2_PACKAGE_VALGRIND=y
BR2_PACKAGE_E2FSPROGS=y
BR2_PACKAGE_E2FSPROGS_RESIZE2FS=y
BR2_PACKAGE_MTD=y
BR2_PACKAGE_SL=y
BR2_PACKAGE_QT5=y
BR2_PACKAGE_QT5BASE_LICENSE_APPROVED=y
BR2_PACKAGE_QT5BASE_EXAMPLES=y
BR2_PACKAGE_QT5BASE_GUI=y
BR2_PACKAGE_QT5BASE_WIDGETS=y
BR2_PACKAGE_QT5BASE_GIF=y
BR2_PACKAGE_QT5BASE_JPEG=y
BR2_PACKAGE_QT5BASE_PNG=y
BR2_PACKAGE_DBUS_PYTHON=y
BR2_PACKAGE_DFU_UTIL=y
BR2_PACKAGE_I2C_TOOLS=y
BR2_PACKAGE_USB_MODESWITCH_DATA=y
BR2_PACKAGE_PYTHON3=y
BR2_PACKAGE_PYTHON3_PY_ONLY=y
BR2_PACKAGE_PYTHON3_READLINE=y
BR2_PACKAGE_PYTHON3_SSL=y
BR2_PACKAGE_OPENSSL_BIN=y
BR2_PACKAGE_OPENSSL_ENGINES=y
BR2_PACKAGE_YAJL=y
BR2_PACKAGE_BOOST=y
BR2_PACKAGE_BOOST_ATOMIC=y
BR2_PACKAGE_BOOST_LOG=y
BR2_PACKAGE_BOOST_PROGRAM_OPTIONS=y
BR2_PACKAGE_BOOST_TEST=y
BR2_PACKAGE_AVAHI=y
BR2_PACKAGE_AVAHI_DAEMON=y
BR2_PACKAGE_CONNMAN=y
BR2_PACKAGE_CONNMAN_WIFI=y
BR2_PACKAGE_CONNMAN_CLIENT=y
BR2_PACKAGE_ETHTOOL=y
BR2_PACKAGE_HOSTAPD=y
BR2_PACKAGE_IW=y
BR2_PACKAGE_MII_DIAG=y
BR2_PACKAGE_OPENSSH=y
BR2_PACKAGE_RSYNC=y
BR2_PACKAGE_GNUPG=y
BR2_PACKAGE_GNUPG_GPGV=y
BR2_PACKAGE_NANO=y
BR2_PACKAGE_UEMACS=y
BR2_PACKAGE_VIM=y
BR2_TARGET_ROOTFS_DEPS=y
BR2_TARGET_ROOTFS_DEPS_UBIFS=y
# BR2_TARGET_ROOTFS_TAR is not set
```

## package/host-python3-setuptools/Config.in
```kconfig
config BR2_PACKAGE_HOST_PYTHON3_SETUPTOOLS
	bool "host-python3-setuptools"
	depends on BR2_PACKAGE_PYTHON3
	depends on BR2_PACKAGE_PYTHON3_PYEXPAT
	help
		Download, build, install, upgrade, and uninstall Python packages.

		http://pypi.python.org/pypi/setuptools
```

## package/python3-codernitydb3/Config.in
```kconfig
config BR2_PACKAGE_PYTHON3_CODERNITYDB3
	bool "python3-codernitydb3"
	depends on BR2_PACKAGE_PYTHON3
	depends on BR2_PACKAGE_HOST_PYTHON3_SETUPTOOLS
	help
		CodernityDB python3 library for a no-sql based database

		https://github.com/andy0130tw/CodernityDB3
```
